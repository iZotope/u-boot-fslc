## board/freescale/gamut/Kconfig
```kconfig
if TARGET_GAMUT

config SYS_BOARD
	default "gamut"

config SYS_VENDOR
	default "freescale"

config SYS_SOC
	default "mx6"

config SYS_CONFIG_NAME
	default "gamut"

endif
```

## configs/gamut_defconfig
```kconfig
CONFIG_ARM=y
CONFIG_ARCH_MX6=y
CONFIG_TARGET_GAMUT=y
CONFIG_SYS_EXTRA_OPTIONS="IMX_CONFIG=board/freescale/gamut/imximage.cfg,MX6SL"
# CONFIG_CMD_IMLS is not set
# CONFIG_CMD_FLASH is not set
# CONFIG_CMD_SETEXPR is not set
CONFIG_DM=y
CONFIG_SPI=y
CONFIG_SPI_FLASH=y
CONFIG_DM_THERMAL=y
CONFIG_CC_OPTIMIZE_FOR_SIZE=n
```
